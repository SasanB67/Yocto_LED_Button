## meta-ledbutton/conf/layer.conf
```bitbake
# Layer configuration for meta-ledbutton
BBPATH .= ":${LAYERDIR}"

BBFILES += "${LAYERDIR}/recipes-*/*/*.bb \
            ${LAYERDIR}/recipes-*/*/*.bbappend"

BBFILE_COLLECTIONS += "ledbutton"
BBFILE_PATTERN_ledbutton = "^${LAYERDIR}/"
BBFILE_PRIORITY_ledbutton = "10"

LAYERDEPENDS_ledbutton = "core openembedded-layer"
LAYERSERIES_COMPAT_ledbutton = "scarthgap"


# Add the LED/button app to any image
IMAGE_INSTALL:append = " ledbutton"
```
