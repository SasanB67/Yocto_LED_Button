## meta-ledtoggle/conf/layer.conf
```bitbake
BBPATH .= ":${LAYERDIR}"

BBFILES += "${LAYERDIR}/recipes-*/*/*.bb \
            ${LAYERDIR}/recipes-*/*/*.bbappend"

BBFILE_COLLECTIONS += "meta-ledtoggle"
BBFILE_PATTERN_meta-ledtoggle = "^${LAYERDIR}/"
BBFILE_PRIORITY_meta-ledtoggle = "6"

LAYERDEPENDS_meta-ledtoggle = "core"
LAYERSERIES_COMPAT_meta-ledtoggle = "scarthgap"
```
